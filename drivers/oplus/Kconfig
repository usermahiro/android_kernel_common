## drivers/oplus/Kconfig
```kconfig
# SPDX-License-Identifier: GPL-2.0-only
menu "OPLUS Features"

config OPLUS_FEATURE
	bool "OPLUS Features"
	default y

if OPLUS_FEATURE

config OPLUS_NANDSWAP
	bool "OPLUS nandswap support"
	depends on SWAP
	default y
	help
	  This option enables OPLUS nandswap feature for ColorOS RAM Expansion.
	  Note: If CONFIG_HYBRIDSWAP or CONFIG_OPLUS_HYBRIDSWAP is enabled,
	  Hybridswap takes priority and Nandswap is automatically disabled.

config OPLUS_HYBRIDSWAP
	bool "OPLUS Hybridswap support"
	depends on ZRAM && MEMCG
	select HYBRIDSWAP
	select HYBRIDSWAP_SWAPD
	select HYBRIDSWAP_CORE
	default y
	help
	  This option enables native OPLUS Hybridswap memory expansion
	  and management in ZRAM. When enabled, Hybridswap takes priority
	  over Nandswap, and Nandswap is automatically disabled at runtime/init.

	  If unsure, say Y.

config OPLUS_ZSTDN
	bool "OPLUS ZSTDN and ZSTDN_O fast compression support"
	depends on ZRAM
	select ZRAM_BACKEND_ZSTDN
	default y
	help
	  This option enables the native OPlus Zstandard-N (zstdn and zstdn_o)
	  fast compression algorithms specifically designed for ColorOS ZRAM.
	  It optimizes the compression window to single 4KB page boundaries
	  (windowLog=12) and applies negative-level match skipping to achieve
	  near-LZ4 speed with superior Zstandard compression ratios.

	  If unsure, say Y.

config OPLUS_HEALTHINFO
	bool "OPLUS healthinfo support"
	default y
	help
	  This option enables OPLUS healthinfo procfs interface (/proc/oplus_healthinfo)
	  for ColorOS performance and system resource management.

config OPLUS_DEVINFO
	bool "OPLUS device info support"
	depends on BLOCK
	default y
	help
	  This option enables the OPlus device info interface (/proc/devinfo).
	  It dynamically discovers attached block storage (UFS/eMMC) and system
	  memory (DDR type/capacity) using standard Linux kernel subsystems.

config OPLUS_SCHED_ASSIST
	bool "OPLUS sched assist support"
	default y
	help
	  This option enables the OPlus scheduler assist interface located at
	  /proc/oplus_scheduler/sched_assist. It provides real-time scene-based
	  CPU frequency QoS boosting and dynamic CFS nice acceleration for
	  user-experience (UX) and critical application threads.

config OPLUS_JANK_INFO
	bool "OPLUS jank info and CLM support"
	depends on OPLUS_HEALTHINFO
	default y
	help
	  This option enables the OPlus CPU jank info interface located at
	  /proc/jank_info/cpu_jank_info. It exposes real-time Core Load
	  Monitoring (CLM), CPU load metrics, and foreground task tracking
	  for ColorOS PerformanceService and FrameBoost telemetries.

config OPLUS_THEIA
	bool "OPLUS Theia stability report support"
	default y
	help
	  This option enables the OPlus Theia and system stability telemetry
	  interfaces (/proc/theiaPwkReport, /proc/pwkMonitorParam,
	  /proc/sau_pwknum, /proc/shutdown_detect, /proc/opbootfrom, and
	  /proc/phoenix) required by vendor stability HAL services.

config OPLUS_AFS_CONFIG
	bool "OPLUS anti-freeze service config support"
	default y
	help
	  This option enables the OPlus application anti-freeze configuration
	  interface located at /proc/oplus_afs_config. It provides dynamic
	  freeze rule persistence and toggle states for ColorOS Athena and
	  SystemUI background optimization services.

config OPLUS_SHELL_TEMP
	bool "OPLUS shell temp driver for horae thermal daemon"
	depends on THERMAL
	default y
	help
	  This option enables the OPlus thermal shell temperature interface
	  located at /proc/shell-temp. It is required by the ColorOS horae
	  thermal daemon (/system_ext/bin/horae) to monitor front, frame,
	  and back skin temperature.

	  If unsure, say Y.

config OPLUS_CHARGER_COMPAT
	bool "OPLUS universal fast charge and charger compatibility"
	default y
	help
	  This option provides universal charger platform stubs (such as smart_charging)
	  and intelligent input current compensation for ColorOS ported ROMs running on
	  Linux 5.10 GKI kernels across MediaTek, Snapdragon, and universal platforms.

	  If unsure, say Y.

endif

endmenu
```
